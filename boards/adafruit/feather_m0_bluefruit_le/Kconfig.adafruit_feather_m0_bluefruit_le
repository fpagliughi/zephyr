## boards/adafruit/feather_m0_bluefruit_le/Kconfig.adafruit_feather_m0_bluefruit_le
```kconfig
# Copyright (c) 2026 Frank Pagliughi
# SPDX-License-Identifier: Apache-2.0

config BOARD_ADAFRUIT_FEATHER_M0_BLUEFRUIT_LE
	select SOC_SAMD21G18A
```

## boards/adafruit/feather_m0_bluefruit_le/board.yml
```yaml
board:
  name: adafruit_feather_m0_bluefruit_le
  full_name: Feather M0 Bluefruit LE
  vendor: adafruit
  socs:
    - name: samd21g18a
```
